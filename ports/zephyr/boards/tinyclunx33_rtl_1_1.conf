## ports/zephyr/boards/tinyclunx33_rtl_1_1.conf
```kconfig
# Hardware features
CONFIG_PINCTRL=n
CONFIG_GPIO=y
CONFIG_VIDEO=y
CONFIG_VIDEO_BUFFER_POOL_HEAP_SIZE=12288
CONFIG_VIDEO_BUFFER_POOL_NUM_MAX=2
CONFIG_CONSOLE_SUBSYS=y
CONFIG_CONSOLE_GETCHAR=y
CONFIG_CONSOLE_GETCHAR_BUFSIZE=1024
CONFIG_CONSOLE_PUTCHAR_BUFSIZE=16
CONFIG_FPU=n
CONFIG_WATCHDOG=n

# Software features
CONFIG_LOG=y
CONFIG_LOG_MODE_MINIMAL=y

# Unsupported features
CONFIG_NETWORKING=n
CONFIG_MICROPY_VFS_FAT=n
CONFIG_MICROPY_VFS_LFS1=n
CONFIG_MICROPY_VFS_LFS2=n

# MicroPython config
CONFIG_MICROPY_HEAP_SIZE=10240
CONFIG_MAIN_STACK_SIZE=4096
CONFIG_MICROPY_CONFIG_ROM_LEVEL_FULL_FEATURES=y

# Threads
CONFIG_THREAD_CUSTOM_DATA=y

# USB
CONFIG_UDC_DRIVER=y
CONFIG_UDC_BUF_POOL_SIZE=4096
CONFIG_USB_DEVICE_STACK_NEXT=y
CONFIG_USBD_VIDEO_NUM_BUFS=2
CONFIG_USBD_VIDEO_CLASS=y
CONFIG_MICROPY_ZEPHYR_USBD_RUNTIME=y
#CONFIG_USBD_CDC_ACM_CLASS=y
```

## ports/zephyr/boards/tinyclunx33_rtl_1_2.conf
```kconfig
# Hardware features.
CONFIG_PINCTRL=n
CONFIG_GPIO=y
CONFIG_VIDEO=y
CONFIG_CONSOLE_SUBSYS=y
CONFIG_CONSOLE_GETCHAR=y
CONFIG_CONSOLE_GETCHAR_BUFSIZE=1024
CONFIG_CONSOLE_PUTCHAR_BUFSIZE=16
CONFIG_FPU=n
CONFIG_WATCHDOG=n

# Software features
CONFIG_LOG=y
CONFIG_LOG_MODE_MINIMAL=y

# Disable networking.
CONFIG_NETWORKING=n

# MicroPython config.
CONFIG_MICROPY_HEAP_SIZE=16384
CONFIG_MAIN_STACK_SIZE=10240
CONFIG_MICROPY_CONFIG_ROM_LEVEL_FULL_FEATURES=y

# Threads
CONFIG_THREAD_CUSTOM_DATA=y

# File System Configuration
CONFIG_FLASH=y
CONFIG_FLASH_MAP=y
CONFIG_FILE_SYSTEM=y
CONFIG_FILE_SYSTEM_LITTLEFS=y
CONFIG_FILE_SYSTEM_MKFS=y
CONFIG_MICROPY_VFS_FAT=y
CONFIG_MICROPY_VFS_LFS1=n
CONFIG_MICROPY_VFS_LFS2=n
# Default heap for littlefs is too small
CONFIG_FS_LITTLEFS_FC_HEAP_SIZE=2048

# USB
# CONFIG_UDC_DRIVER=y
# CONFIG_UDC_BUF_POOL_SIZE=4096
# CONFIG_USB_DEVICE_STACK_NEXT=y
# CONFIG_USBD_VIDEO_CLASS=y
# CONFIG_MICROPY_ZEPHYR_USBD_RUNTIME=y
# CONFIG_USBD_CDC_ACM_CLASS=y
```
